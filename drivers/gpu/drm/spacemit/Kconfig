## drivers/gpu/drm/spacemit/Kconfig
```kconfig
# SPDX-License-Identifier: GPL-2.0

config DRM_SPACEMIT
	tristate "DRM support for SpacemiT display controllers"
	depends on DRM && OF && MMU
	depends on ARCH_SPACEMIT || COMPILE_TEST
	select DRM_BRIDGE_CONNECTOR
	select DRM_CLIENT_SELECTION
	select DRM_DISPLAY_HELPER
	select DRM_KMS_HELPER
	select DRM_GEM_SHMEM_HELPER
	select REGMAP_MMIO
	select VIDEOMODE_HELPERS
	help
	  Choose this option if you have a SpacemiT SoC with the Saturn
	  display processing unit, such as the K3. The DPU scans out
	  framebuffers through its private display MMU and feeds a
	  DisplayPort or embedded DisplayPort controller.

	  If M is selected the module will be called spacemit-drm.

config SPACEMIT_INNO_DP
	tristate "SpacemiT Innosilicon DP/eDP controller support"
	depends on DRM_SPACEMIT
	imply PHY_SPACEMIT_K3_INNO_DP
	select GENERIC_PHY
	select DRM_PANEL
	select DRM_BRIDGE_CONNECTOR
	select DRM_DISPLAY_HELPER
	select DRM_DISPLAY_DP_HELPER
	select DRM_DISPLAY_DP_AUX_BUS
	help
	  Choose this option to enable the Innosilicon DisplayPort /
	  embedded DisplayPort transmitter integrated in SpacemiT SoCs.
	  The controller sits downstream of the Saturn DPU and drives an
	  eDP panel (discovered over the DP AUX bus) or an external
	  DisplayPort connector.

	  If M is selected the module will be called spacemit-inno-dp.

config SPACEMIT_HDMI
	tristate "HDMI transmitter support for SpacemiT K1"
	depends on DRM_SPACEMIT
	select DRM_KMS_HELPER
	help
	  Support for the HDMI transmitter block found on the SpacemiT K1
	  family.  Say M here to build it as a module called spacemit_hdmi.
```
